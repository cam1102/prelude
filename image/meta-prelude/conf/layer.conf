## image/meta-prelude/conf/layer.conf
```bitbake
BBPATH .= ":${LAYERDIR}"
PRELUDE_LAYERDIR := "${LAYERDIR}"

BBFILES += "${LAYERDIR}/recipes-*/*/*.bb \
            ${LAYERDIR}/recipes-*/*/*.bbappend"

BBFILE_COLLECTIONS += "prelude"
BBFILE_PATTERN_prelude = "^${LAYERDIR}/"
BBFILE_PRIORITY_prelude = "20"

LAYERSERIES_COMPAT_prelude = "wrynose"
LAYERDEPENDS_prelude = "core superbird openembedded-layer multimedia-layer"
```
